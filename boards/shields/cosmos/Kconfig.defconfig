## dts/bindings/behaviors/roi,behavior-pointer-speed.yaml
```yaml
description: Adjust pointer or scroll speed for the current power-on session
compatible: "roi,behavior-pointer-speed"
include: zero_param.yaml
properties:
  scroll:
    type: boolean
    description: Adjust scroll speed rather than pointer movement
  increase:
    type: boolean
    description: Increase speed by 25 percentage points; otherwise decrease it
```

## dts/bindings/input_processors/roi,cmd-scroll.yaml
```yaml
description: Reversed slow Cmd / fast Shift scrolling with independent runtime pointer gain
compatible: "roi,cmd-scroll"
include: ip_zero_param.yaml
properties:
  fast-scroll-divisor:
    type: int
    required: true
  slow-scroll-divisor:
    type: int
    required: true
  scroll-multiplier:
    type: int
    required: true
```
